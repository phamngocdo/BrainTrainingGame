#include "i2c.h"

const uint8_t Font5x7[][5] = {
    {0x00, 0x00, 0x00, 0x00, 0x00}, // (space) - 0
    {0x00, 0x00, 0x5F, 0x00, 0x00}, // !
    {0x00, 0x07, 0x00, 0x07, 0x00}, // "
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    {0x20, 0x10, 0x08, 0x04, 0x02}, // /

    // Numbers 0-9 - 16-25
    {0x3E, 0x51, 0x49, 0x45, 0x3E}, // 0
    {0x00, 0x42, 0x7F, 0x40, 0x00}, // 1
    {0x42, 0x61, 0x51, 0x49, 0x46}, // 2
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    {0x32, 0x49, 0x79, 0x41, 0x3E}, // @

    // Uppercase letters A-Z - 33-58
    {0x7E, 0x11, 0x11, 0x11, 0x7E}, // A
    {0x7F, 0x49, 0x49, 0x49, 0x36}, // B
    {0x3E, 0x41, 0x41, 0x41, 0x22}, // C
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    {0x00, 0x01, 0x02, 0x04, 0x00}, // `

    // Lowercase letters a-z - 59-84
    {0x20, 0x54, 0x54, 0x54, 0x78}, // a
    {0x7F, 0x48, 0x44, 0x44, 0x38}, // b
    {0x38, 0x44, 0x44, 0x44, 0x20}, // c
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    {0x08, 0x1C, 0x2A, 0x08, 0x08}  // ←
};


// I2C1 Init (PB8=SCL, PB9=SDA)
void I2C1_Init(void) {
    RCC->AHB1ENR |= 1 << 1;       // Enable clock to port B
    RCC->APB1ENR |= 1 << 21;      // Enable clock to I2C1

    GPIOB->MODER &= ~(1 << (8 * 2));      // PB8: AF
    GPIOB->MODER |=  (1 << (8 * 2 + 1));

    GPIOB->MODER &= ~(1 << (9 * 2));      // PB9: AF
    GPIOB->MODER |=  (1 << (9 * 2 + 1));

    GPIOB->OTYPER |= (1 << 8);            // PB8: Open-drain

    GPIOB->OTYPER |= (1 << 9);            // PB9: Open-drain

    GPIOB->PUPDR &= ~(1 << (8 * 2 + 1));  // PB8: Pull-up
    GPIOB->PUPDR |=  (1 << (8 * 2));

    GPIOB->PUPDR &= ~(1 << (9 * 2 + 1));  // PB9: Pull-up
    GPIOB->PUPDR |=  (1 << (9 * 2));

    GPIOB->AFR[1] |=  (0b0100 << 0);    // AF4 for PB8
    GPIOB->AFR[1] |=  (0b0100 << 4);    // AF4 for PB9

    I2C1->CR1 &= ~(1 << 0);             // Disable I2C1

    I2C1->CR2 = 42;                     // Peripheral clock frequency = 42 MHz
    I2C1->CCR = 210;                    // Clock control for standard mode
    I2C1->TRISE = 43;                   // Maximum rise time

    I2C1->CR1 |= 1 << 0;                // Enable I2C1
}

// Send Data to SSD1306
#define SSD1306_ADDR 0x78

void SSD1306_Send(uint8_t control, uint8_t *data, uint16_t size) {
    I2C1->CR1 |= 1 << 8;                       // Start

    while (!(I2C1->SR1 & (1 << 0)));           // Wait Start bit is set

    I2C1->DR = SSD1306_ADDR;                   // Send Slave Address

    while (!(I2C1->SR1 & (1 << 1)));           // Wait ADDR is set

    (void)I2C1->SR2;                           // Read SR2 to delete ADDR flag

    while (!(I2C1->SR1 & (1 << 7)));           // Wait until TXE
    I2C1->DR = control;                        // Send control byte

    for (int i = 0; i < size; i++) {
    	while (!(I2C1->SR1 & (1 << 7)));       // Wait until TXE = 1
        I2C1->DR = data[i];                    // Send data byte
    }

    while (!(I2C1->SR1 & (1 << 2)));           // Wait until BTF
    I2C1->CR1 |= (1 << 9);                     // Send STOP condition
}

// Initialize SSD1306
void SSD1306_Init(void) {
    uint8_t cmds[] = {
        0xAE, 0x20, 0x00, 0xB0, 0xC8,
        0x00, 0x10, 0x40, 0x81, 0x7F,
        0xA1, 0xA6, 0xA8, 0x3F, 0xA4,
        0xD3, 0x00, 0xD5, 0xF0, 0xD9,
        0x22, 0xDA, 0x12, 0xDB, 0x20,
        0x8D, 0x14, 0xAF
    };
    SSD1306_Send(0x00, cmds, sizeof(cmds));
}

// Clear screen
void SSD1306_Clear(void) {
    uint8_t zero[128] = {0};
    for (uint8_t page = 0; page < 8; page++) {
        uint8_t cmd[] = {0x21, 0, 127, 0x22, page, page};
        SSD1306_Send(0x00, cmd, sizeof(cmd));
        SSD1306_Send(0x40, zero, 128);
    }
}

void SSD1306_DrawChar(uint8_t col, uint8_t page, const uint8_t *bitmap) {
    uint8_t cmd[] = {
        0x21, col, col + 4,
        0x22, page, page
    };
    SSD1306_Send(0x00, cmd, sizeof(cmd));
    SSD1306_Send(0x40, (uint8_t*)bitmap, 5);
}


